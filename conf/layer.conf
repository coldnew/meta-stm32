## conf/layer.conf
```bitbake
# We have a conf and classes directory, add to BBPATH
BBPATH .= ":${LAYERDIR}"

# We have recipes-* directories, add to BBFILES
BBFILES += "${LAYERDIR}/recipes-*/*/*.bb \
	${LAYERDIR}/recipes-*/*/*.bbappend"

BBFILE_COLLECTIONS += "stm32"
BBFILE_PATTERN_stm32 = "^${LAYERDIR}/"
BBFILE_PRIORITY_stm32 = "6"
```

## conf/machine/include/arm/arch-armv7m.inc
```bitbake
DEFAULTTUNE ?= "armv7m"

TUNEVALID[armv7m] = "Enable instructions for ARMv7-a"
TUNECONFLICTS[armv7m] = "armv4 armv5 armv6 armv7 armv7a"
TUNE_CCARGS .= "${@bb.utils.contains("TUNE_FEATURES", "armv7m", " -march=armv7-m", "", d)}"
MACHINEOVERRIDES =. "${@bb.utils.contains("TUNE_FEATURES", "armv7m", "armv7m:", "" ,d)}"

require conf/machine/include/arm/arch-armv6.inc
# require conf/machine/include/arm/feature-arm-thumb.inc

# Little Endian base configs
AVAILTUNES += "armv7m"
ARMPKGARCH_tune-armv7m ?= "armv7m"
TUNE_FEATURES_tune-armv7m ?= "arm armv7m"
PACKAGE_EXTRA_ARCHS_tune-armv7m = "${PACKAGE_EXTRA_ARCHS_tune-armv6} armv7m"
```

## conf/machine/include/tune-cortexm4.inc
```bitbake
DEFAULTTUNE ?= "cortexm4"

require conf/machine/include/arm/arch-armv7a.inc

TUNEVALID[cortexm4] = "Enable Cortex-M4 specific processor optimizations"
TUNE_CCARGS .= "${@bb.utils.contains("TUNE_FEATURES", "cortexm4", " -mtune=cortex-m4", "", d)}"

TUNEVALID[armv4m] = "Enable Cortex-M4 specific processor optimizations"
TUNE_CCARGS .= "${@bb.utils.contains("TUNE_FEATURES", "armv4m", " -march=armv4-m", "", d)}"

AVAILTUNES += "cortexm4"
ARMPKGARCH_tune-cortexm4 ?= "armv4m"
TUNE_FEATURES_tune-cortexm4 ?= "armv4m vfp cortexm4 thumb"
PACKAGE_EXTRA_ARCHS_tune-cortexm4 = "${PACKAGE_EXTRA_ARCHS_tune-armv4at} armv4m-vfp armv4mt2-vfp"
```

## conf/machine/include/tune-cortexm7.inc
```bitbake
DEFAULTTUNE ?= "cortexm7"

require conf/machine/include/arm/arch-armv7a.inc

TUNEVALID[cortexm7] = "Enable Cortex-M7 specific processor optimizations"
TUNE_CCARGS .= "${@bb.utils.contains("TUNE_FEATURES", "cortexm7", " -mtune=cortex-m7", "", d)}"

TUNEVALID[armv7m] = "Enable Cortex-M7 specific processor optimizations"
TUNE_CCARGS .= "${@bb.utils.contains("TUNE_FEATURES", "armv7m", " -march=armv7-m", "", d)}"

AVAILTUNES += "cortexm7"
ARMPKGARCH_tune-cortexm7 ?= "armv7m"
TUNE_FEATURES_tune-cortexm7 ?= "armv7m vfp cortexm7"
PACKAGE_EXTRA_ARCHS_tune-cortexm7 = "${PACKAGE_EXTRA_ARCHS_tune-armv7at} armv7m-vfp"
```

## conf/machine/stm32f429-discovery.conf
```bitbake
#@TYPE: Machine
#@NAME: stm32f429-discovery (ARM cortex-M4)
#@SOC:
#@DESCRIPTION:
#@MAINTAINER: Yen-Chin, Lee <coldnew.tw@gmail.com>

require include/tune-cortexm4.inc

# Allow for MMC booting (required by the NAND-less)
EXTRA_IMAGEDEPENDS += ""
MACHINE_FEATURES = ""

# Factory default are RO images: add following line to your target image
IMAGE_FEATURES += "read-only-rootfs"

SERIAL_CONSOLE = "115200;ttyS0"

PREFERRED_PROVIDER_virtual/kernel ?= "linux-yocto"
#KERNEL_DEVICETREE = ""

# KERNEL_IMAGETYPE = "zImage"

UBOOT_MACHINE = "stm32f429-discovery_defconfig"
UBOOT_SUFFIX = "bin"

TCLIBC = "baremetal"
```

## conf/machine/stm32f7-discovery.conf
```bitbake
#@TYPE: Machine
#@NAME: stm32f7-discovery (ARM cortex-M7)
#@DESCRIPTION:

require include/arm/arch-armv7m.inc

# Allow for MMC booting (required by the NAND-less)
EXTRA_IMAGEDEPENDS += ""

IMAGE_FSTYPES += "tar.bz2 ext3"

# 2.6.37 and later kernels use OMAP_SERIAL, ttyO2
# earlier kernels use ttyS2
SERIAL_CONSOLE = "115200 ttyO2"

# PREFERRED_PROVIDER_virtual/kernel ?= "linux-yocto"

# KERNEL_IMAGETYPE = "zImage"

# UBOOT_MACHINE = "ca9x4_ct_vxp_config"
# UBOOT_ENTRYPOINT = "0x80008000"
# UBOOT_LOADADDRESS = "0x80008000"

TCLIBC = "uclibc"
```

## conf/machine/stm32f746-discovery.conf
```bitbake
#@TYPE: Machine
#@NAME: stm32f746-discovery (ARM cortex-M7)
#@SOC:
#@DESCRIPTION:
#@MAINTAINER: Yen-Chin, Lee <coldnew.tw@gmail.com>

require include/tune-cortexm7.inc

# Allow for MMC booting (required by the NAND-less)
EXTRA_IMAGEDEPENDS += ""

# Factory default are RO images: add following line to your target image
IMAGE_FEATURES = "read-only-rootfs"

SERIAL_CONSOLE = "115200 ttyS0"

PREFERRED_PROVIDER_virtual/kernel ?= "linux-yocto"

# KERNEL_IMAGETYPE = "zImage"

UBOOT_MACHINE = "stm32f746-disco_defconfig"
# UBOOT_ENTRYPOINT = "0x80008000"
# UBOOT_LOADADDRESS = "0x80008000"

TCLIBC = "baremetal"

#PREFERRED_PROVIDER_virtual/kernel ?= "uclinux-stm32f7-discovery"

UBOOT_MACHINE = "stm32f746-disco_defconfig"
UBOOT_SUFFIX = "bin"
SPL_BINARY = "spl/u-boot-spl.bin"
```
